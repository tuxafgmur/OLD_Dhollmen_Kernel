## drivers/gpu/ion/Kconfig
```kconfig
menuconfig ION
	tristate "Ion Memory Manager"
	select GENERIC_ALLOCATOR
	help
	  Chose this option to enable the ION Memory Manager.

config ION_OMAP
	tristate "Ion for OMAP"
	depends on ARCH_OMAP4 && ION && TI_TILER
	help
	  Choose this option if you wish to use ion on OMAP4.
```

## drivers/sensors/optical/Kconfig
```kconfig
config OPTICAL_BH1721
         tristate "Rohm bh1721 Optical Sensor"
         depends on I2C
         default n

config OPTICAL_AL3201
         tristate "Rohm al3201 Optical Sensor"
         depends on I2C
         default n

config OPTICAL_GP2AP020A00F
	depends on I2C
	bool "Sharp GP2AP020A00F driver"
	default n
```

## fs/exfat/Kconfig
```kconfig
config EXFAT_FS
	tristate "exFAT fs support"
	select NLS
	default y
	help
	  exFAT (Extended File Allocation Table) is a Microsoft file system optimized for flash drives.
	  Can be used where the NTFS file system is not a feasible solution, due to data structure overhead,
	  or where the file size limit of the standard FAT32 file system is unacceptable.
	  Unlike NTFS, exFAT cannot pre-allocate disk space for a file by just marking arbitrary space on disk
	  as 'allocated'.

  	  To compile this file system support as a module, choose M here.
  	  The module will be called exfat.ko

config EXFAT_DISCARD
	bool "enable discard support"
	depends on EXFAT_FS
	default y

config EXFAT_DELAYED_SYNC
	bool "enable delayed sync"
	depends on EXFAT_FS
	default n

config EXFAT_KERNEL_DEBUG
	bool "enable kernel debug features via ioctl"
	depends on EXFAT_FS
	default n

config EXFAT_DEBUG_MSG
	bool "print debug messages"
	depends on EXFAT_FS
	default n

config EXFAT_DEFAULT_CODEPAGE
	int "Default codepage for exFAT"
	default 437
	depends on EXFAT_FS
	help
	  This option should be set to the codepage of your exFAT filesystems.

config EXFAT_DEFAULT_IOCHARSET
	string "Default iocharset for exFAT"
	default "utf8"
	depends on EXFAT_FS
	help
	  Set this to the default input/output character set you'd like exFAT to use.
```
